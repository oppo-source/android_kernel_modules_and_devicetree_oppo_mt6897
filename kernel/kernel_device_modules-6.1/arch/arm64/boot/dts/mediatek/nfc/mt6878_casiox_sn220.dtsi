/**********************************************************************************
* Copyright (c)  2008-2020  Guangdong oplus Mobile Comm Corp., Ltd
*
***********************************************************************************/
&odm {
    nfc_chipset:nfc_chipset {
       compatible = "oplus-nfc-chipset";
       chipset-24706 = "SN220E";
       manifest = "/odm/etc/vintf/manifest_nfc_pn560.xml";
    };
};


&i2c3 {
       status = "okay";
       clock-frequency = <400000>;
       nq@28 {
       compatible = "nxp,sn-nci";
       reg = <0x28>;
       nxp,sn-irq = <&pio 2 0x0>;
       nxp,sn-ven-rstn = <&pio 40 0x0>;
       interrupt-parent = <&pio>;
       };
};
