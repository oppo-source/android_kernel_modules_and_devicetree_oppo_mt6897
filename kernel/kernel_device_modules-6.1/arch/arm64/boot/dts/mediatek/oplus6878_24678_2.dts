// SPDX-License-Identifier: (GPL-2.0 OR MIT)
/*
 * Copyright (C) 2022 MediaTek Inc.
 */
/dts-v1/;
/plugin/;
#include <dt-bindings/interrupt-controller/arm-gic.h>
#include <dt-bindings/interrupt-controller/irq.h>
#include <dt-bindings/phy/phy.h>
#include <dt-bindings/pinctrl/mt6878-pinfunc.h>

&odm {
	oplus_project:oplus_project {
		compatible = "oplus,oplus_project";
	};
    
    oplus_boardid:oplus_boardid {
		compatible = "oplus,oplus_boardid-v2";
		support-dtsino=<24678>;//only one u32
		/*first one is low 32bit, last one is highest 32bit, must be 32-bit for 4gpios*/
		support-pcbmask=<0xffffffff 0xffffffff 0xffffffff>;
	};
};

/*End of this file, DO NOT ADD ANYTHING HERE*/
